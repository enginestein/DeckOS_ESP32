#include <string.h>
#include <stdlib.h>
#include <stdarg.h>
#include <stdio.h>
#include <math.h>
#include "hal.h"
#include "oled.h"

#define OLED_I2C_ADDR   0x3C
#define OLED_PAGES      8
#define FONT_W          6
#define FONT_H          8
#define OLED_COLS       (OLED_WIDTH / FONT_W)
#define OLED_ROWS       (OLED_HEIGHT / FONT_H)

#define SSD1306_SET_CONTRAST        0x81
#define SSD1306_DISPLAY_ALL_ON_RAM  0xA4
#define SSD1306_DISPLAY_ALL_ON      0xA5
#define SSD1306_DISPLAY_NORMAL      0xA6
#define SSD1306_DISPLAY_INVERT      0xA7
#define SSD1306_DISPLAY_OFF         0xAE
#define SSD1306_DISPLAY_ON          0xAF
#define SSD1306_SET_MEM_MODE        0x20
#define SSD1306_SET_COL_ADDR        0x21
#define SSD1306_SET_PAGE_ADDR       0x22
#define SSD1306_SET_DISP_START_LINE 0x40
#define SSD1306_SET_SEG_REMAP       0xA0
#define SSD1306_SET_MUX_RATIO       0xA8
#define SSD1306_SET_COM_OUT_DIR     0xC0
#define SSD1306_SET_DISP_OFFSET     0xD3
#define SSD1306_SET_COM_PIN_CFG     0xDA
#define SSD1306_SET_DISP_CLK_DIV    0xD5
#define SSD1306_SET_PRECHARGE       0xD9
#define SSD1306_SET_VCOM_DESEL      0xDB
#define SSD1306_CHARGE_PUMP         0x8D
#define SSD1306_SCROLL_RIGHT        0x26
#define SSD1306_SCROLL_LEFT         0x27
#define SSD1306_SCROLL_STOP         0x2E
#define SSD1306_SCROLL_START        0x2F

static uint s_sda, s_scl;
static bool s_ready = false;
static uint8_t s_fb[OLED_WIDTH * OLED_PAGES];

static const uint8_t FONT5x8[][5] = {
    {0x00,0x00,0x00,0x00,0x00},
    {0x00,0x00,0x5F,0x00,0x00},
    {0x00,0x07,0x00,0x07,0x00},
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    {0x10,0x08,0x08,0x10,0x08},
};

static void oled_cmd(uint8_t cmd) {
    uint8_t buf[2] = { 0x00, cmd };
    hal_i2c_write(OLED_I2C_ADDR, buf, 2);
}

static void oled_cmd2(uint8_t cmd, uint8_t arg) {
    uint8_t buf[3] = { 0x00, cmd, arg };
    hal_i2c_write(OLED_I2C_ADDR, buf, 3);
}

static void fb_pixel(int x, int y, bool on) {
    if (x < 0 || x >= OLED_WIDTH || y < 0 || y >= OLED_HEIGHT) return;
    int page = y / 8, bit = y % 8;
    if (on) s_fb[page * OLED_WIDTH + x] |=  (1u << bit);
    else    s_fb[page * OLED_WIDTH + x] &= ~(1u << bit);
}

bool oled_init(uint sda, uint scl) {
    s_sda = sda;
    s_scl = scl;

    hal_i2c_init(sda, scl, 400000);
    hal_sleep_ms(10);

    uint8_t rxbuf;
    if (hal_i2c_read(OLED_I2C_ADDR, &rxbuf, 1) < 0)
        return false;

    static const uint8_t init_seq[] = {
        SSD1306_DISPLAY_OFF,
        SSD1306_SET_DISP_CLK_DIV, 0x80,
        SSD1306_SET_MUX_RATIO,    0x3F,
        SSD1306_SET_DISP_OFFSET,  0x00,
        SSD1306_SET_DISP_START_LINE | 0x00,
        SSD1306_CHARGE_PUMP,      0x14,
        SSD1306_SET_MEM_MODE,     0x00,
        SSD1306_SET_SEG_REMAP | 0x01,
        SSD1306_SET_COM_OUT_DIR | 0x08,
        SSD1306_SET_COM_PIN_CFG,  0x12,
        SSD1306_SET_CONTRAST,     0xCF,
        SSD1306_SET_PRECHARGE,    0xF1,
        SSD1306_SET_VCOM_DESEL,   0x40,
        SSD1306_DISPLAY_ALL_ON_RAM,
        SSD1306_DISPLAY_NORMAL,
        SSD1306_DISPLAY_ON,
    };
    for (size_t i = 0; i < sizeof(init_seq); i++)
        oled_cmd(init_seq[i]);

    memset(s_fb, 0, sizeof(s_fb));
    oled_flush();
    s_ready = true;
    return true;
}

void oled_on(void)             { if (s_ready) oled_cmd(SSD1306_DISPLAY_ON); }
void oled_off(void)            { if (s_ready) oled_cmd(SSD1306_DISPLAY_OFF); }
void oled_clear(void)          { memset(s_fb, 0x00, sizeof(s_fb)); }

void oled_flush(void) {
    if (!s_ready) return;
    oled_cmd(SSD1306_SET_COL_ADDR);  oled_cmd(0); oled_cmd(OLED_WIDTH - 1);
    oled_cmd(SSD1306_SET_PAGE_ADDR); oled_cmd(0); oled_cmd(OLED_PAGES - 1);

    uint8_t buf[OLED_WIDTH + 1];
    buf[0] = 0x40;
    for (int p = 0; p < OLED_PAGES; p++) {
        memcpy(buf + 1, s_fb + p * OLED_WIDTH, OLED_WIDTH);
        hal_i2c_write(OLED_I2C_ADDR, buf, sizeof(buf));
    }
}

void oled_pixel(int x, int y, int on) { fb_pixel(x, y, on); }

void oled_text(int col, int row, const char* s) {
    int x = col * FONT_W;
    int y = row * FONT_H;
    while (*s && col < OLED_COLS) {
        char c = *s++;
        if (c < 0x20 || c > 0x7E) c = '?';
        const uint8_t* glyph = FONT5x8[c - 0x20];
        for (int cx = 0; cx < 5; cx++) {
            for (int cy = 0; cy < 8; cy++)
                fb_pixel(x + cx, y + cy, (glyph[cx] >> cy) & 1);
        }
        for (int cy = 0; cy < 8; cy++)
            fb_pixel(x + 5, y + cy, 0);
        x += FONT_W;
        col++;
    }
}

void oled_set_contrast(uint8_t val) {
    oled_cmd2(SSD1306_SET_CONTRAST, val);
}

void oled_invert(int on) {
    oled_cmd(on ? SSD1306_DISPLAY_INVERT : SSD1306_DISPLAY_NORMAL);
}

void oled_display(void) { oled_flush(); }
