## sdkconfig.defaults
```kconfig
CONFIG_IDF_TARGET="esp32"
CONFIG_ESPTOOLPY_FLASHSIZE_4MB=y
CONFIG_ESPTOOLPY_FLASHFREQ_80M=y
CONFIG_ESPTOOLPY_FLASHMODE_DIO=y
CONFIG_PARTITION_TABLE_CUSTOM=y
CONFIG_PARTITION_TABLE_CUSTOM_FILENAME="partitions.csv"

CONFIG_FREERTOS_HZ=1000

CONFIG_ESP32_DEFAULT_CPU_FREQ_240=y
CONFIG_ESP_SYSTEM_EVENT_TASK_STACK_SIZE=4096

# CONFIG_SPI_FLASH_SIZE_OVERRIDE is not set

CONFIG_LWIP_LOCAL_HOSTNAME="DeckOS"

CONFIG_CONSOLE_UART_DEFAULT=y
CONFIG_CONSOLE_UART_BAUDRATE=115200

CONFIG_SPIFFS_USE_MAGIC=y
CONFIG_SPIFFS_USE_MAGIC_LENGTH=y
CONFIG_SPIFFS_META_LENGTH=4
CONFIG_SPIFFS_OBJ_NAME_LEN=32
CONFIG_SPIFFS_MAX_PARTITIONS=1

# Disable BT temporarily to save DRAM
# CONFIG_BT_ENABLED is not set
# CONFIG_BTDM_CONTROLLER_MODE_BTDM is not set
# CONFIG_BT_CLASSIC_ENABLED is not set
# CONFIG_BT_SPP_ENABLED is not set

CONFIG_ESP_WIFI_STATIC_RX_BUFFER_NUM=8
CONFIG_ESP_WIFI_DYNAMIC_RX_BUFFER_NUM=16
CONFIG_ESP_WIFI_TX_BUFFER_NUM=16

CONFIG_ESP32_SPIRAM_SUPPORT=y
CONFIG_SPIRAM_TYPE_AUTO=y
CONFIG_SPIRAM_IGNORE_NOTFOUND=y
CONFIG_SPIRAM_USE_CAPS_ALLOC=y
```
